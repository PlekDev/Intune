## C3/src/Kconfig.projbuild
```kconfig
menu "INTUNE arm supervisor"

choice ARM_LINK
    prompt "Enlace con el brazo"
    default ARM_LINK_UART
    config ARM_LINK_UART
        bool "UART (conector 40 pines del brazo, decisión del equipo)"
    config ARM_LINK_ESPNOW
        bool "ESP-NOW (sin cables)"
endchoice

config ARM_LINK_TX_GPIO
    int "GPIO TX hacia el brazo (pin 8 del conector de 40 pines)"
    depends on ARM_LINK_UART
    default 17

config ARM_LINK_RX_GPIO
    int "GPIO RX desde el brazo (pin 10 del conector de 40 pines)"
    depends on ARM_LINK_UART
    default 16

config ARM_AP_SSID
    string "SSID del AP del RoArm-M2-S (para encontrar su canal y MAC)"
    default "RoArm-M2"

config ARM_ESPNOW_CMD
    int "Campo cmd por defecto (1 = JSON en callback Wi-Fi del brazo, 2 = JSON en loop())"
    range 1 2
    default 2
    help
        Con 1 el brazo ejecuta el JSON dentro del callback de Wi-Fi, en paralelo con loop(),
        que también usa el bus de servos: riesgo de colisiones. 2 lo ejecuta en loop().

config ARM_S3_UART_TX_GPIO
    int "GPIO TX hacia el S3 (UART2)"
    default 27

config ARM_S3_UART_RX_GPIO
    int "GPIO RX desde el S3 (UART2)"
    default 26

config ARM_SYNC_GPIO
    int "GPIO del pulso de sync hacia el S3"
    default 25

config ARM_LED_GPIO
    int "GPIO del LED de estado"
    default 2

config ARM_BUTTON_GPIO
    int "GPIO del botón del operador (activo en bajo)"
    default 0
    help
        BOOT en el DevKit. Pulsación corta = confirmar pausa (nivel 2),
        larga (2 s) = rearmar tras parada (nivel 3 o heartbeat perdido).

config ARM_LEVEL1_SPEED_PCT
    int "Velocidad en nivel 1 (% de la nominal)"
    range 5 100
    default 40

endmenu
```

## firmware/arm_esp32/src/Kconfig.projbuild
```kconfig
menu "INTUNE arm supervisor"

config ARM_AP_SSID
    string "SSID del AP del RoArm-M2-S (para encontrar su canal y MAC)"
    default "RoArm-M2"

config ARM_ESPNOW_CMD
    int "Campo cmd por defecto (1 = JSON en callback Wi-Fi del brazo, 2 = JSON en loop())"
    range 1 2
    default 2
    help
        Con 1 el brazo ejecuta el JSON dentro del callback de Wi-Fi, en paralelo con loop(),
        que también usa el bus de servos: riesgo de colisiones. 2 lo ejecuta en loop().

endmenu
```

## firmware/bridge_esp32/sdkconfig.defaults
```kconfig
# Bluetooth Classic únicamente (Bluedroid + SPP), sin BLE
CONFIG_BT_ENABLED=y
CONFIG_BT_BLUEDROID_ENABLED=y
CONFIG_BT_CLASSIC_ENABLED=y
CONFIG_BT_SPP_ENABLED=y
CONFIG_BT_BLE_ENABLED=n
CONFIG_BTDM_CTRL_MODE_BR_EDR_ONLY=y
CONFIG_BTDM_CTRL_MODE_BLE_ONLY=n
CONFIG_BTDM_CTRL_MODE_BTDM=n
CONFIG_BT_SSP_ENABLED=y
# CPU a 240 MHz
CONFIG_ESP_DEFAULT_CPU_FREQ_MHZ_240=y
CONFIG_FREERTOS_HZ=1000
# esp32dev = 4 MB
CONFIG_ESPTOOLPY_FLASHSIZE_4MB=y
```

## firmware/bridge_esp32/src/Kconfig.projbuild
```kconfig
menu "Unicorn bridge"

config UNICORN_MAC
    string "MAC del Unicorn (AA:BB:CC:DD:EE:FF)"
    default "60:B6:47:E1:27:0F"

config UNICORN_SCN
    int "Canal RFCOMM (0 = obtener por SDP)"
    range 0 30
    default 0

config UNICORN_INQUIRY_FIRST
    bool "Hacer inquiry antes de cada conexión"
    default y
    help
        Sin inquiry el ESP32 recibía Page Timeout (0x4) mientras la PC (que hace
        inquiry) conectaba. Se corta en cuanto aparece la MAC del Unicorn.

config UNICORN_SEC_AUTH
    bool "Exigir autenticación (ESP_SPP_SEC_AUTHENTICATE)"
    default n
    help
        En Linux el Unicorn aceptó RFCOMM sin emparejar. Activar solo si falla sin seguridad.

config UNICORN_PIN
    string "PIN para legacy pairing (si lo pide)"
    default "0000"

config BRIDGE_UART_BAUD
    int "Baud UART hacia el S3"
    default 921600

config BRIDGE_UART_TX_GPIO
    int "GPIO TX UART hacia el S3"
    default 17

config BRIDGE_UART_RX_GPIO
    int "GPIO RX UART (no usado, reservado)"
    default 16

config BRIDGE_STATUS_GPIO
    int "GPIO de estado hacia el S3 (alto = streaming)"
    default 4

config BRIDGE_LED_GPIO
    int "GPIO del LED (-1 = sin LED)"
    default 2

config BRIDGE_BUTTON_GPIO
    int "GPIO botón stop/reanudar, activo bajo (-1 = sin botón)"
    default 0

config BRIDGE_STATS_PERIOD_S
    int "Periodo de stats por log (s)"
    default 5

config BRIDGE_RX_TIMEOUT_MS
    int "Sin datos en streaming durante este tiempo => reconectar (ms)"
    default 3000

config BRIDGE_UNFILTERED
    bool "Enviar µV sin filtrar (sin IIR 1-15 Hz), flag UNFILTERED"
    default n
    help
        Solo para comparar. Los huecos se tratan igual (ZOH + flags).

config BRIDGE_LINK_RAW
    bool "Enviar también tramas EEG_RAW (µV sin filtrar) para verificar el IIR"
    default y
    help
        Duplica el tráfico (~24 % de 921600). El S3 las ignora. Desactivar para la demo.

config BRIDGE_LINK_MIRROR_CONSOLE
    bool "Copiar las tramas link al USB (UART0) para graficarlas en la PC"
    default y
    help
        UART0 pasa a BRIDGE_UART_BAUD y se silencian los logs tras el arranque (romperían
        las tramas binarias). Las stats llegan en las tramas STATUS.
        Leer con tools/linux_probe/link_view.py. Desactivar para ver logs con pio monitor.

config BRIDGE_BT_DEBUG_LOGS
    bool "Logs BT (GAP/SPP) en DEBUG"
    default n

endmenu
```

## firmware/detector_s3/src/Kconfig.projbuild
```kconfig
menu "INTUNE detector"

choice DETECTOR_INPUT
    prompt "Formato del enlace desde el puente (C1)"
    default DETECTOR_INPUT_LINK

config DETECTOR_INPUT_LINK
    bool "link_protocol.h (EEG filtrado, flags y STATUS del puente)"

config DETECTOR_INPUT_RAW_UNICORN
    bool "Tramas Unicorn crudas (respaldo: el S3 aplica el IIR 1-15 Hz)"
endchoice

config DETECTOR_LINK_BAUD
    int "Baud UART desde el puente"
    default 921600

config DETECTOR_LINK_RX_GPIO
    int "GPIO RX UART desde el puente (TX del puente = GPIO17)"
    default 18

config DETECTOR_BRIDGE_STATUS_GPIO
    int "GPIO de estado del puente (alto = streaming, -1 = no usar)"
    default 8

config DETECTOR_ARM_TX_GPIO
    int "GPIO TX UART hacia el brazo (no 43/44: son la consola UART0)"
    default 17

config DETECTOR_ARM_RX_GPIO
    int "GPIO RX UART desde el brazo"
    default 16

config DETECTOR_SYNC_GPIO
    int "GPIO del pulso de sincronía del brazo (flanco de subida = t0)"
    default 5

config DETECTOR_EVENT_LATENCY_OFFSET_US
    int "EVENT_LATENCY_OFFSET (us), medido en la prueba 10"
    default 0
    help
        Retardo constante entre el flanco de sincronía y la muestra Unicorn
        correspondiente (buffering BT/UART + retardo de grupo del IIR). Se resta
        del tiempo del flanco antes de convertirlo a contador.

config DETECTOR_GATE_GYRO_DPS
    int "Gate de movimiento: rango pico a pico de gyro por eje en la ventana (°/s, 0 = off)"
    default 30
    help
        Igual que build_dataset.py (C4). Debe coincidir con el gate_gyro con el que
        C4 construyó el dataset; se afina con build_dataset.py --suggest-gyro.

config DETECTOR_EEG_TIMEOUT_MS
    int "Sin tramas válidas durante este tiempo => EEG perdido (nivel 3)"
    default 500

config DETECTOR_CALIB_EPOCHS
    int "Epochs limpios para calibrar normalización y umbrales"
    default 80
    range 30 150

config DETECTOR_CALIB_BUTTON_GPIO
    int "Botón para recalibrar, activo bajo (-1 = sin botón)"
    default 0

config DETECTOR_CALIB_ON_BOOT
    bool "Calibrar en cada arranque (el contacto de electrodos cambia entre sesiones)"
    default y
    help
        Si está desactivado, usa la última calibración guardada en NVS o, si no
        hay, los valores offline de errp_params.h.

config DETECTOR_USE_LDA
    bool "Usar el LDA como scorer de alertas en vez del autoencoder"
    default n
    help
        Respaldo previsto en CLAUDE.md si el autoencoder rinde poco. Ambos
        scores se calculan y se reportan siempre; esto solo elige cuál decide.

config DETECTOR_SELFTEST_ON_BOOT
    bool "Correr la prueba de epochs de referencia (prueba 12) al arrancar"
    default y

endmenu
```
